## conf/machine/include/amlogic-s905d3.inc
```bitbake
# Amlogic S905D3 Configurations

require conf/machine/include/arm/armv8-2a/tune-cortexa55.inc
require conf/machine/include/amlogic-meson64.inc

MACHINE_FEATURES = "serial usbhost sdio screen wifi"

SOC_FAMILY:append = ":meson-sm1"
```

## conf/machine/include/sports-cle-v41-dtb.inc
```bitbake
# MT Sports CLE V41 dtb

KERNEL_DEVICETREE += "amlogic/meson-g12b-sports-cle-v41.dtb"
IMAGE_BOOT_FILES += "meson-g12b-sports-cle-v41.dtb"
```

## conf/machine/include/sports-cle-v4x-dtb.inc
```bitbake
# MT Sports CLE V41 dtb

KERNEL_DEVICETREE += "amlogic/meson-g12b-sports-cle-v41.dtb amlogic/meson-sm1-sports-cle-v4.dtb"
IMAGE_BOOT_FILES += "meson-g12b-sports-cle-v41.dtb meson-sm1-sports-cle-v4.dtb"
```

## conf/machine/include/sports-cle-v4x.inc
```bitbake
#@TYPE: Machine
#@NAME: Sports CLE V40/V41 machine
#@DESCRIPTION: Machine configuration

KERNEL_IMAGETYPE = "Image"

require conf/machine/include/sports-cle-v4x-dtb.inc
require conf/machine/include/amlogic-modern-boot.inc

#UBOOT_MACHINE ?= "sports-cle-v41_defconfig"

MACHINE_FEATURES:append = " alsa ext2 screen usbgadget usbhost vfat"

#PREFERRED_VERSION_linux-meson64 = "5.15%"
#PREFERRED_PROVIDER_virtual/kernel = "linux-meson64"

PREFERRED_VERSION_linux-yocto = "5.10%"

PREFERRED_VERSION_libgpiod = "1.%"

MACHINE_EXTRA_RRECOMMENDS += "kernel-modules"
MACHINE_EXTRA_RRECOMMENDS += "linux-firmware-rtl8192cu"
#MACHINE_EXTRA_RRECOMMENDS += "linux-firmware-rtl8723"
MACHINE_EXTRA_RRECOMMENDS += "linux-firmware-rtl8821 kernel-module-rtl8821cs"
#MACHINE_EXTRA_RRECOMMENDS += "kernel-module-rtw88"
MACHINE_EXTRA_RRECOMMENDS += "zram"
MACHINE_EXTRA_RRECOMMENDS += "udev-rules-sports-cle-v4"
MACHINE_EXTRA_RRECOMMENDS += "u-boot-tools"
```

## conf/machine/qihua-s905d3.conf
```bitbake
# Qihua s905d3 board

require conf/machine/include/amlogic-s905d3.inc

KERNEL_IMAGETYPE = "uImage"
KERNEL_DEVICETREE = "amlogic/meson-sm1-qihua-s905d3.dtb amlogic/meson-sm1-sports-cle-v4.dtb"
#IMAGE_BOOT_FILES = "extlinux.conf;extlinux/extlinux.conf meson-sm1-sei610.dtb meson-sm1-khadas-vim3l.dtb meson-g12a-u200.dtb meson-g12a-x96-max.dtb"

PREFERRED_PROVIDER_amlogic-fip = "amlogic-fip-prebuilt"
PREFERRED_PROVIDER_virtual/bootloader = "u-boot-meson-gx"
PREFERRED_PROVIDER_u-boot = "u-boot-meson-gx"
PREFERRED_VERSION_u-boot-meson-gx = "2021.04%"
PREFERRED_VERSION_u-boot-tools = "2021.04%"

UBOOT_MACHINE = "odroid-c4_defconfig"
#UBOOT_EXTLINUX = "1"
#UBOOT_EXTLINUX_ROOT = "root=/dev/mmcblk0p2"
#UBOOT_EXTLINUX_FDT = "../meson-sm1-qihua-s905d3.dtb"
#UBOOT_EXTLINUX_CONSOLE = "console=ttyAML0"

MACHINE_ESSENTIAL_EXTRA_RDEPENDS += " \
       kernel-image \
       kernel-devicetree \
       u-boot-meson-gx \
       u-boot-tools \
"

MACHINE_EXTRA_RRECOMMENDS += "linux-firmware-rtl8821 kernel-module-8821cu rtl8821cu"
MACHINE_EXTRA_RRECOMMENDS += "linux-firmware-rtl8723 rtl8723du kernel-module-8723du"
MACHINE_EXTRA_RRECOMMENDS += "openocd python3-esptool"

#INITRAMFS_FSTYPES = "cpio.xz"
#INITRAMFS_IMAGE ?= "core-image-minimal"
INITRAMFS_IMAGE_BUNDLE = "1"

# Generate an SDCard Image
IMAGE_CLASSES += "image_types_meson"


WKS_FILE = "sdimage-meson.wks"
#WKS_FILE = "sdimage-bootpart-meson.wks"
```

## conf/machine/sports-cle-v40.conf
```bitbake
#@TYPE: Machine
#@NAME: Sports CLE V40 machine
#@DESCRIPTION: Machine configuration

require conf/machine/include/amlogic-s905d3.inc
require conf/machine/include/sports-cle-v4x.inc

UBOOT_MACHINE = "qihua-s905d3_defconfig"
```

## conf/machine/sports-cle-v41.conf
```bitbake
#@TYPE: Machine
#@NAME: Sports CLE V41 machine
#@DESCRIPTION: Machine configuration

require conf/machine/include/amlogic-s922x.inc
require conf/machine/include/sports-cle-v4x.inc

UBOOT_MACHINE = "sports-cle-v41_defconfig"
```
